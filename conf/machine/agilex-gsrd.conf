## conf/machine/stratix10-gsrd.conf
```bitbake
#@TYPE: Machine
#@NAME: Intel SoCFPGA Stratix10
#@DESCRIPTION: Machine configuration for the Stratix 10 SoCFPGA

IMAGE_TYPE:stratix10 ?= "gsrd"

UBOOT_CONFIG:stratix10 ?= "stratix10-socdk-atf stratix10-socdk-qspi-atf"

KERNEL_DEVICETREE = " "

MACHINE_ESSENTIAL_EXTRA_RRECOMMENDS:append:stratix10 = " \
		kernel-modules \
		device-tree \
		hw-ref-design \
		"

EXTRA_IMAGEDEPENDS:append:stratix10 = " u-boot-socfpga-scr"

IMAGE_BOOT_FILES:stratix10 = " \
		boot.scr.uimg \
		u-boot.itb \
		kernel.itb \
		"
```

## conf/machine/stratix10_htile-gsrd.conf
```bitbake
#@TYPE: Machine
#@NAME: Intel SoCFPGA Stratix10 H-Tile
#@DESCRIPTION: Machine configuration for the Stratix 10 SoCFPGA

IMAGE_TYPE:stratix10_htile ?= "gsrd"

UBOOT_CONFIG:stratix10_htile ?= "stratix10-socdk-atf stratix10-socdk-qspi-atf"

KERNEL_DEVICETREE = " "

MACHINE_ESSENTIAL_EXTRA_RRECOMMENDS:append:stratix10_htile = " \
		kernel-modules \
		device-tree \
		hw-ref-design \
		"

EXTRA_IMAGEDEPENDS:append:stratix10_htile = " \
		u-boot-socfpga-scr \
		u-boot-socfpga-env \
		"

IMAGE_BOOT_FILES:stratix10_htile = " \
		boot.scr.uimg \
		u-boot.itb \
		kernel.itb \
		"
```

## recipes-bsp/u-boot/files/agilex5_uboot_script.its
```
// SPDX-License-Identifier: GPL-2.0
/*
 * Copyright (C) 2023 Intel Corporation
 *
 */

/dts-v1/;

/ {
    description = "FIT image for u-boot script";
    images {
         default = "script";
         script {
             description = "u-boot script";
             data = /incbin/("./agilex5_uboot.txt");
             type = "script";
             compression = "none";
             hash {
                 algo = "crc32";
             };
        };
    };
};
```

## recipes-bsp/u-boot/files/agilex5_uboot_script_xen.its
```
// SPDX-License-Identifier: GPL-2.0
/*
 * Copyright (C) 2023 Intel Corporation
 *
 */

/dts-v1/;

/ {
    description = "FIT image for u-boot script";
    images {
         default = "script";
         script {
             description = "u-boot xen script";
             data = /incbin/("./agilex5_uboot_xen.txt");
             type = "script";
             compression = "none";
             hash {
                 algo = "crc32";
             };
        };
    };
};
```

## recipes-bsp/u-boot/files/agilex5_uboot_script_xen_debug.its
```
// SPDX-License-Identifier: GPL-2.0
/*
 * Copyright (C) 2024 Intel Corporation
 *
 */

/dts-v1/;

/ {
    description = "FIT image for u-boot script";
    images {
         default = "script";
         script {
             description = "u-boot xen script";
             data = /incbin/("./agilex5_uboot_xen_debug.txt");
             type = "script";
             compression = "none";
             hash {
                 algo = "crc32";
             };
        };
    };
};
```
