/dts-v1/;
/plugin/;
/ {
	fragment@1 {
		target-path = "/soc/base_fpga_region/fpga_pr_region0";
		#address-cells = <0x2>;
		#size-cells = <0x2>;
		__overlay__ {
			partial-fpga-config;
			firmware-name = "persona1.rbf";
			#address-cells = <0x2>;
			#size-cells = <0x2>;

			region-unfreeze-timeout-us = <5000>;
			region-freeze-timeout-us = <5000>;
			config-complete-timeout-us = <2000000>;

			pr_region_0_pr_clk_100: pr_region_0_pr_clk_100 {
				compatible = "fixed-clock";
				#clock-cells = <0>;
				clock-frequency = <100000000>;	/* 100.00 MHz */
				clock-output-names = "pr_region_0_pr_clk_100-clk";
			};

			pr_region_0_pr_sysid_qsys_0: sysid@0x0900 {
				compatible = "altr,sysid-16.1", "altr,sysid-1.0";
				reg = <0x0 0x00000900 0x0 0x00000008>;
				clocks = <&pr_region_0_pr_clk_100>;
				id = <3405707982>;	/* embeddedsw.dts.params.id type NUMBER */
				timestamp = <0>;	/* embeddedsw.dts.params.timestamp type NUMBER */
			};
		};
	};
};
