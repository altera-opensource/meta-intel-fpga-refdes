/dts-v1/;
/plugin/;
/ {
	fragment@0 {
		target-path = "/soc/base_fpga_region";
		#address-cells = <0x2>;
		#size-cells = <0x2>;
		__overlay__ {
			#address-cells = <0x2>;
			#size-cells = <0x2>;

			ranges = <0x00000000 0x0 0xF9000000 0x0 0x00200000>;

			external-fpga-config;

			clocks = <&clk_0>;
			clock-names = "fpga_clock";

			clk_0: clk_0 {
				compatible = "fixed-clock";
				#clock-cells = <0>;
				clock-frequency = <100000000>;
				clock-output-names = "clk_0-clk";
			};

			fpga_pr_region0 {
				compatible = "fpga-region";
				fpga-bridges = <&freeze_controller_0>;
				ranges;
				#address-cells = <0x2>;
				#size-cells = <0x2>;
			};

			freeze_controller_0: freeze_controller@0x0450 {
				compatible = "altr,freeze_controller-16.1", "altr,freeze-bridge-controller";
				reg = <0x0 0x00000450 0x0 0x00000010>;
				interrupt-parent = <&intc>;
				/*interrupts = <0 21 4>;*/
				clocks = <&clk_0>;
			};

		};
	};
};
