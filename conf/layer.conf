## conf/layer.conf
```bitbake
# We have a conf and classes directory, append to BBPATH
BBPATH .= ":${LAYERDIR}"

# Security backport version preferences
PREFERRED_VERSION_curl = "8.20.0"
PREFERRED_VERSION_expat = "2.8.1"
PREFERRED_VERSION_libxml2 = "2.15.3"

AGILEX3_QSPI_BUILD ??= "0"
BBFILES:append = "${@bb.utils.contains('AGILEX3_QSPI_BUILD', '1', ' ${LAYERDIR}/recipes-images/poky/core-image-minimal.bbappend', ' \
    ${LAYERDIR}/recipes-connectivity/*/*.bbappend \
    ${LAYERDIR}/recipes-gsrd/socfpga-gsrd*/*.bb \
    ${LAYERDIR}/recipes-gsrd/socfpga-intel*/*.bb \
    ${LAYERDIR}/recipes-gsrd/socfpga-lighttpd*/*.bb \
    ${LAYERDIR}/recipes-connectivity/*/*.bb \
    ${LAYERDIR}/recipes-tools/*/*.bb \
    ${LAYERDIR}/recipes-core/*/*.bb  \
    ${LAYERDIR}/recipes-core/*/*.bbappend \
    ${LAYERDIR}/recipes-images/*/*.bb \
    ${LAYERDIR}/recipes-support/*/*.bb \
    ', d)}"

# We have a recipes directory, add to BBFILES
BBFILES:append = " ${LAYERDIR}/recipes-bsp/*/*.bb"
BBFILES:append = " ${LAYERDIR}/recipes-bsp/*/*.bbappend"
BBFILES:append = " ${LAYERDIR}/recipes-kernel/*/*.bbappend"
BBFILES:append = " ${LAYERDIR}/recipes-devtools/*/*.bbappend"

# default root home directory
ROOT_HOME = "/home/root"

# Conditionally include recipes-extended if HYP_BUILD is set to 1
HYP_BUILD ??= "0"

BBFILES:append = "${@bb.utils.contains('HYP_BUILD', '1', ' ${LAYERDIR}/recipes-extended/*/*.bbappend ${LAYERDIR}/recipes-extended/*/*.bb ${LAYERDIR}/recipes-gsrd/socfpga-xen-passthrough/*.bb', '', d)}"

BBFILE_COLLECTIONS:append = " meta-intel-fpga-refdes"
BBFILE_PATTERN_meta-intel-fpga-refdes := "^${LAYERDIR}/"

# Increase the layer priority
BBFILE_PRIORITY_meta-intel-fpga-refdes = "20"

LAYERSERIES_COMPAT_meta-intel-fpga-refdes = "wrynose"
```

## conf/machine/agilex3-gsrd.conf
```bitbake
#@TYPE: Machine
#@NAME: Altera SoCFPGA Agilex3
#@DESCRIPTION: Additional machine configuration for the Agilex3 SoCFPGA

IMAGE_TYPE:agilex3 ?= "gsrd"

UBOOT_CONFIG:agilex3 ?= "agilex3-socdk-atf"

KERNEL_DEVICETREE = " "

64MB_QSPI_BUILD ?= "0"
MACHINE_ESSENTIAL_EXTRA_RRECOMMENDS:append:agilex3 = "${@' kernel-modules device-tree hw-ref-design' if d.getVar('64MB_QSPI_BUILD') != '1' else ''}"
EXTRA_IMAGEDEPENDS:append:agilex3 = "${@' u-boot-socfpga-scr' if d.getVar('64MB_QSPI_BUILD') != '1' else ''}"

IMAGE_BOOT_FILES:agilex3 = " \
		boot.scr.uimg \
		u-boot.itb \
		kernel.itb \
		"
HYP_BUILD ?= "0"
XEN_EXTRA_PACKAGES = ""
XEN_EXTRA_PACKAGES:append = "${@'kernel-module-xen-blkback kernel-module-xen-gntalloc kernel-module-xen-gntdev kernel-module-xen-netback kernel-module-xen-wdt xen xen-tools xen-tools-xenstat ' if d.getVar('HYP_BUILD') == '1' else ''}"
IMAGE_INSTALL:append:agilex3 = "${@' socfpga-xen-passthrough' if d.getVar('HYP_BUILD') == '1' else ''}"
IMAGE_BOOT_FILES:append:agilex3 = "${@' xen Image devicetree/socfpga_agilex3_vanilla.dtb boot.scr.xen.uimg agilex3_gsrd_ghrd/ghrd.core.rbf' if d.getVar('HYP_BUILD') == '1' else ''}"
```

## conf/machine/agilex5_dk_a5e013bb32aes-gsrd.conf
```bitbake
#@TYPE: Machine
#@NAME: Altera SoCFPGA Agilex5
#@DESCRIPTION: Additional machine configuration for the Agilex5 SoCFPGA

IMAGE_TYPE:agilex5_dk_a5e013bb32aes ?= "gsrd"

UBOOT_CONFIG:agilex5_dk_a5e013bb32aes ?= "agilex5_dk_a5e013bb32aes-socdk-atf agilex5_dk_a5e013bb32aes-socdk-nand-atf"

KERNEL_DEVICETREE = " "

IMAGE_INSTALL:append:agilex5_dk_a5e013bb32aes = " \
		${@bb.utils.contains( 'IMAGE_BASENAME', "gsrd-console-image", " packagegroup-tsn-essential", "", d)} \
		"

MACHINE_ESSENTIAL_EXTRA_RRECOMMENDS:append:agilex5_dk_a5e013bb32aes = " \
		kernel-modules \
		device-tree \
		hw-ref-design \
		"

EXTRA_IMAGEDEPENDS:append:agilex5_dk_a5e013bb32aes = " \
		u-boot-socfpga-scr \
		"

IMAGE_BOOT_FILES:agilex5_dk_a5e013bb32aes = " \
		boot.scr.uimg \
		u-boot.itb \
		kernel.itb \
		"

HYP_BUILD ?= "0"
XEN_EXTRA_PACKAGES = ""
XEN_EXTRA_PACKAGES:append = "${@'kernel-module-xen-blkback kernel-module-xen-gntalloc kernel-module-xen-gntdev kernel-module-xen-netback kernel-module-xen-wdt xen xen-tools xen-tools-xenstat ' if d.getVar('HYP_BUILD') == '1' else ''}"
IMAGE_INSTALL:append:agilex5_dk_a5e013bb32aes = "${@' socfpga-xen-passthrough' if d.getVar('HYP_BUILD') == '1' else ''}"
IMAGE_BOOT_FILES:append:agilex5_dk_a5e013bb32aes = "${@' xen Image devicetree/socfpga_agilex5_vanilla.dtb devicetree/socfpga_agilex5_socdk_emmc_vanilla.dtb boot.scr.xen.uimg boot.scr.xen.emmc.uimg agilex5_dk_a5e013bb32aes_gsrd_ghrd/ghrd.core.rbf agilex5_dk_a5e013bb32aes_gsrd_ghrd/emmc.core.rbf' if d.getVar('HYP_BUILD') == '1' else ''}"
```

## conf/machine/agilex5_dk_a5e013bm16aea-gsrd.conf
```bitbake
#@TYPE: Machine
#@NAME: Altera SoCFPGA Agilex5
#@DESCRIPTION: Additional machine configuration for the Agilex5 SoCFPGA

IMAGE_TYPE:agilex5_dk_a5e013bm16aea ?= "gsrd"

UBOOT_CONFIG:agilex5_dk_a5e013bm16aea ?= "agilex5_dk_a5e013bm16aea-socdk-atf"

KERNEL_DEVICETREE = " "

64MB_QSPI_BUILD ?= "0"
MACHINE_ESSENTIAL_EXTRA_RRECOMMENDS:append:agilex5_dk_a5e013bm16aea = "${@' kernel-modules device-tree hw-ref-design' if d.getVar('64MB_QSPI_BUILD') != '1' else ''}"
EXTRA_IMAGEDEPENDS:append:agilex5_dk_a5e013bm16aea = "${@' u-boot-socfpga-scr' if d.getVar('64MB_QSPI_BUILD') != '1' else ''}"

IMAGE_BOOT_FILES:agilex5_dk_a5e013bm16aea = " \
		boot.scr.uimg \
		u-boot.itb \
		kernel.itb \
		"
HYP_BUILD ?= "0"
XEN_EXTRA_PACKAGES = ""
XEN_EXTRA_PACKAGES:append = "${@'kernel-module-xen-blkback kernel-module-xen-gntalloc kernel-module-xen-gntdev kernel-module-xen-netback kernel-module-xen-wdt xen xen-tools xen-tools-xenstat ' if d.getVar('HYP_BUILD') == '1' else ''}"
IMAGE_INSTALL:append:agilex5_dk_a5e013bm16aea = "${@' socfpga-xen-passthrough' if d.getVar('HYP_BUILD') == '1' else ''}"
IMAGE_BOOT_FILES:append:agilex5_dk_a5e013bm16aea = "${@' xen Image devicetree/socfpga_agilex5_vanilla_013b.dtb boot.scr.xen.uimg agilex5_dk_a5e013bm16aea_gsrd_ghrd/ghrd.core.rbf' if d.getVar('HYP_BUILD') == '1' else ''}"
```

## conf/machine/agilex5_dk_a5e065bb32aes1_b0-gsrd.conf
```bitbake
#@TYPE: Machine
#@NAME: Altera SoCFPGA Agilex5
#@DESCRIPTION: Additional machine configuration for the Agilex5 SoCFPGA

IMAGE_TYPE:agilex5_dk_a5e065bb32aes1_b0 ?= "gsrd"

UBOOT_CONFIG:agilex5_dk_a5e065bb32aes1_b0 ?= "agilex5_dk_a5e065bb32aes1_b0-socdk-atf agilex5_dk_a5e065bb32aes1_b0-socdk-nand-atf"

KERNEL_DEVICETREE = " "

IMAGE_INSTALL:append:agilex5_dk_a5e065bb32aes1_b0 = " \
		${@bb.utils.contains( 'IMAGE_BASENAME', "gsrd-console-image", " packagegroup-tsn-essential", "", d)} \
		"

MACHINE_ESSENTIAL_EXTRA_RRECOMMENDS:append:agilex5_dk_a5e065bb32aes1_b0 = " \
		kernel-modules \
		device-tree \
		hw-ref-design \
		"

EXTRA_IMAGEDEPENDS:append:agilex5_dk_a5e065bb32aes1_b0 = " \
		u-boot-socfpga-scr \
		"

IMAGE_BOOT_FILES:agilex5_dk_a5e065bb32aes1_b0 = " \
		boot.scr.uimg \
		u-boot.itb \
		kernel.itb \
		"
HYP_BUILD ?= "0"
XEN_EXTRA_PACKAGES = ""
XEN_EXTRA_PACKAGES:append = "${@'kernel-module-xen-blkback kernel-module-xen-gntalloc kernel-module-xen-gntdev kernel-module-xen-netback kernel-module-xen-wdt xen xen-tools xen-tools-xenstat ' if d.getVar('HYP_BUILD') == '1' else ''}"
IMAGE_INSTALL:append:agilex5_dk_a5e065bb32aes1_b0 = "${@' socfpga-xen-passthrough' if d.getVar('HYP_BUILD') == '1' else ''}"
IMAGE_BOOT_FILES:append:agilex5_dk_a5e065bb32aes1_b0 = "${@' xen Image devicetree/socfpga_agilex5_vanilla.dtb boot.scr.xen.uimg agilex5_dk_a5e065bb32aes1_b0_gsrd_ghrd/ghrd.core.rbf' if d.getVar('HYP_BUILD') == '1' else ''}"
```

## conf/machine/agilex5_mk_a5e065bb32aes1-gsrd.conf
```bitbake
#@TYPE: Machine
#@NAME: Altera SoCFPGA Agilex5
#@DESCRIPTION: Additional machine configuration for the Agilex5 SoCFPGA

IMAGE_TYPE:agilex5_mk_a5e065bb32aes1 ?= "gsrd"

UBOOT_CONFIG:agilex5_mk_a5e065bb32aes1 ?= "agilex5_mk_a5e065bb32aes1-socdk-atf"

KERNEL_DEVICETREE = " "

IMAGE_INSTALL:append:agilex5_mk_a5e065bb32aes1 = " \
		${@bb.utils.contains( 'IMAGE_BASENAME', "gsrd-console-image", " packagegroup-tsn-essential", "", d)} \
		"

MACHINE_ESSENTIAL_EXTRA_RRECOMMENDS:append:agilex5_mk_a5e065bb32aes1 = " \
		kernel-modules \
		device-tree \
		hw-ref-design \
		"

EXTRA_IMAGEDEPENDS:append:agilex5_mk_a5e065bb32aes1 = " \
		u-boot-socfpga-scr \
		"

IMAGE_BOOT_FILES:agilex5_mk_a5e065bb32aes1 = " \
		boot.scr.uimg \
		u-boot.itb \
		kernel.itb \
		"
HYP_BUILD ?= "0"
XEN_EXTRA_PACKAGES = ""
XEN_EXTRA_PACKAGES:append = "${@'kernel-module-xen-blkback kernel-module-xen-gntalloc kernel-module-xen-gntdev kernel-module-xen-netback kernel-module-xen-wdt xen xen-tools xen-tools-xenstat ' if d.getVar('HYP_BUILD') == '1' else ''}"
IMAGE_INSTALL:append:agilex5_mk_a5e065bb32aes1 = "${@' socfpga-xen-passthrough' if d.getVar('HYP_BUILD') == '1' else ''}"
IMAGE_BOOT_FILES:append:agilex5_mk_a5e065bb32aes1 =  "${@' xen Image devicetree/socfpga_agilex5_vanilla_modular.dtb  boot.scr.xen.uimg agilex5_mk_a5e065bb32aes1_gsrd_ghrd/ghrd.core.rbf' if d.getVar('HYP_BUILD') == '1' else ''}"
```

## conf/machine/agilex7_dk_dev_agf023fa-gsrd.conf
```bitbake
#@TYPE: Machine
#@NAME: Altera SoCFPGA Agilex7 DK-DEV-AGF023FA
#@DESCRIPTION: Additional machine configuration for the Agilex7 DK-DEV-AGF023FA SoCFPGA

IMAGE_TYPE ?= "gsrd"

UBOOT_CONFIG ?= "agilex-socdk-atf agilex-socdk-qspi-atf"

KERNEL_DEVICETREE = " "

MACHINE_ESSENTIAL_EXTRA_RRECOMMENDS:append ?= " \
		kernel-modules \
		device-tree \
		hw-ref-design \
		"

EXTRA_IMAGEDEPENDS:append ?= " \
		u-boot-socfpga-scr \
		u-boot-socfpga-env \
		"

IMAGE_BOOT_FILES = " \
		boot.scr.uimg \
		u-boot.itb \
		kernel.itb \
		"

HYP_BUILD ?= "0"
XEN_EXTRA_PACKAGES = ""
XEN_EXTRA_PACKAGES:append = "${@'kernel-module-xen-blkback kernel-module-xen-gntalloc kernel-module-xen-gntdev kernel-module-xen-netback kernel-module-xen-wdt xen xen-tools xen-tools-xenstat ' if d.getVar('HYP_BUILD') == '1' else ''}"
IMAGE_INSTALL:append:agilex7_dk_dev_agf023fa = "${@' socfpga-xen-passthrough' if d.getVar('HYP_BUILD') == '1' else ''}"
IMAGE_BOOT_FILES:append:agilex7_dk_dev_agf023fa = "${@' xen Image devicetree/socfpga_agilex7_vanilla.dtb boot.scr.xen.uimg agilex7_dk_dev_agf023fa_gsrd_ghrd/ghrd.core.rbf' if d.getVar('HYP_BUILD') == '1' else ''}"
```

## recipes-bsp/u-boot/files/agilex3_uboot_script.its
```
// SPDX-License-Identifier: GPL-2.0
/*
 * Copyright (C) 2025 Altera Corporation
 *
 */

/dts-v1/;

/ {
    description = "FIT image for u-boot script";
    images {
         default = "script";
         script {
             description = "Agilex3 u-boot script";
             data = /incbin/("./agilex3_uboot.txt");
             type = "script";
             compression = "none";
             hash {
                 algo = "crc32";
             };
        };
    };
};
```

## recipes-bsp/u-boot/files/agilex5_013b_uboot_script_xen.its
```
// SPDX-License-Identifier: GPL-2.0
/*
 * Copyright (C) 2025 Altera Corporation
 *
 */

/dts-v1/;

/ {
    description = "FIT image for u-boot script";
    images {
         default = "script";
         script {
             description = "u-boot xen script";
             data = /incbin/("./agilex5_013b_uboot_xen.txt");
             type = "script";
             compression = "none";
             hash {
                 algo = "crc32";
             };
        };
    };
};
```

## recipes-kernel/linux/linux-socfpga-lts/fit_kernel_agilex5_dk_a5e013bb32aes_5s.its
```
// SPDX-License-Identifier: GPL-2.0
/*
 * Copyright (C) 2025 Altera Corporation
 *
 */

/dts-v1/;

/ {
	description = "FIT image with kernel, DTB and FPGA core binary";
	#address-cells = <1>;

	images {
		kernel {
			description = "Linux Kernel";
			data = /incbin/("./Image.lzma");
			type = "kernel";
			arch = "arm64";
			os = "linux";
			compression = "lzma";
			load = <0x86000000>;
			entry = <0x86000000>;
			hash {
				algo = "crc32";
			};
		};

		fdt-0 {
			description = "socfpga_socdk_vanilla";
			data = /incbin/("./socfpga_agilex5_vanilla.dtb");
			type = "flat_dt";
			arch = "arm64";
			compression = "none";
			hash {
				algo = "crc32";
			};
		};

		fdt-2 {
            description = "socfpga_socdk_emmc";
            data = /incbin/("./socfpga_agilex5_socdk_emmc.dtb");
            type = "flat_dt";
            arch = "arm64";
            compression = "none";
			hash {
                algo = "crc32";
            };
        };

		fdt-4 {
            description = "socfpga_socdk_combined";
            data = /incbin/("./socfpga_agilex5_socdk.dtb");
            type = "flat_dt";
            arch = "arm64";
            compression = "none";
            hash {
                algo = "crc32";
            };
        };

		fdt-10 {
            description = "socfpga_socdk_tsn_cfg2";
            data = /incbin/("./socfpga_agilex5_socdk_tsn_cfg2.dtb");
            type = "flat_dt";
            arch = "arm64";
            compression = "none";
            hash {
                algo = "crc32";
            };
        };

		fpga-2 {
            description = "FPGA bitstream for EMMC";
            data = /incbin/("./emmc.core.rbf");
            type = "fpga";
            arch = "arm64";
            compression = "none";
            load = <0x8A000000>;
            hash {
                algo = "crc32";
            };
        };

        fpga-4 {
            description = "FPGA bitstream for GHRD";
            data = /incbin/("./ghrd.core.rbf");
            type = "fpga";
            arch = "arm64";
            compression = "none";
            load = <0x8A000000>;
            hash {
                algo = "crc32";
            };
        };

		fpga-6 {
            description = "FPGA bitstream for TSN CONFIG2";
            data = /incbin/("./tsnconfig2.core.rbf");
            type = "fpga";
            arch = "arm64";
            compression = "none";
            load = <0x8A000000>;
            hash {
                algo = "crc32";
            };
        };
	};

	configurations {
		default = "board-0";

		board-0 {
			description = "board_0";
			kernel = "kernel";
			fdt = "fdt-0";
			signature {
				algo = "crc32";
				key-name-hint = "dev";
				sign-images = "fdt-0", "kernel";
			};
		};

		board-2 {
            description = "board_2";
            kernel = "kernel";
            fdt = "fdt-2";
            fpga = "fpga-2";
            signature {
                algo = "crc32";
                key-name-hint = "dev";
                sign-images = "fdt-2", "kernel", "fpga-2";
            };
        };

        board-4 {
            description = "board_4";
            kernel = "kernel";
            fdt = "fdt-4";
            fpga = "fpga-4";
            signature {
                algo = "crc32";
                key-name-hint = "dev";
                sign-images = "fdt-4", "kernel", "fpga-4";
            };
        };

		board-10 {
            description = "board_10";
            kernel = "kernel";
            fdt = "fdt-10";
            fpga = "fpga-6";
            signature {
                algo = "crc32";
                key-name-hint = "dev";
                sign-images = "fdt-10", "kernel", "fpga-6";
            };
        };
	};
};
```
