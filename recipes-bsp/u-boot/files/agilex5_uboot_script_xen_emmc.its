## recipes-bsp/u-boot/files/agilex5_uboot_script_xen_emmc.its
```
// SPDX-License-Identifier: GPL-2.0
/*
 * Copyright (C) 2024 Intel Corporation
 *
 */

/dts-v1/;

/ {
    description = "FIT image for u-boot script";
    images {
         default = "script";
         script {
             description = "u-boot xen script for nand dc";
             data = /incbin/("./agilex5_uboot_xen_emmc.txt");
             type = "script";
             compression = "none";
             hash {
                 algo = "crc32";
             };
        };
    };
};
```

## recipes-bsp/u-boot/files/uboot_script.its
```
// SPDX-License-Identifier: GPL-2.0
/*
 * Copyright (C) 2019 Intel Corporation
 *
 */

/dts-v1/;

/ {
    description = "FIT image for u-boot script";
    images {
         default = "script";
         script {
             description = "u-boot script";
             data = /incbin/("./uboot.txt");
             type = "script";
             compression = "none";
             hash {
                 algo = "crc32";
             };
        };
    };
};
```

## recipes-kernel/linux/linux-socfpga-lts/fit_kernel_agilex.its
```
// SPDX-License-Identifier: GPL-2.0
/*
 * Copyright (C) 2019 Intel Corporation
 *
 */

/dts-v1/;

/ {
	description = "FIT image with kernel, DTB and FPGA core binary";
	#address-cells = <1>;

	images {
		kernel {
			description = "Linux Kernel";
			data = /incbin/("./Image.lzma");
			type = "kernel";
			arch = "arm64";
			os = "linux";
			compression = "lzma";
			load = <0x6000000>;
			entry = <0x6000000>;
			hash {
				algo = "crc32";
			};
		};

		fdt-0 {
			description = "socfpga_socdk";
			data = /incbin/("./socfpga_agilex_socdk.dtb");
			type = "flat_dt";
			arch = "arm64";
			compression = "none";
			hash {
				algo = "crc32";
			};
		};

		fdt-1 {
			description = "socfpga_socdk_nand";
			data = /incbin/("./socfpga_agilex_socdk_nand.dtb");
			type = "flat_dt";
			arch = "arm64";
			compression = "none";
			hash {
				algo = "crc32";
			};
		};

		fdt-3 {
			description = "socfpga_socdk_pr";
			data = /incbin/("./socfpga_agilex_socdk_pr.dtb");
			type = "flat_dt";
			arch = "arm64";
			compression = "none";
			hash {
				algo = "crc32";
			};
		};

		fpga-0 {
			description = "FPGA bitstream for GHRD";
			data = /incbin/("./ghrd.core.rbf");
			type = "fpga";
			arch = "arm64";
			compression = "none";
			load = <0xA000000>;
			hash {
				algo = "crc32";
			};
		};

		fpga-1 {
			description = "FPGA bitstream for NAND";
			data = /incbin/("./nand.core.rbf");
			type = "fpga";
			arch = "arm64";
			compression = "none";
			load = <0xA000000>;
			hash {
				algo = "crc32";
			};
		};

		fpga-3 {
			description = "FPGA bitstream for PR";
			data = /incbin/("./ghrd_pr.core.rbf");
			type = "fpga";
			arch = "arm64";
			compression = "none";
			load = <0xA000000>;
			hash {
				algo = "crc32";
			};
		};
	};

	configurations {
		default = "board-0";

		board-0 {
			description = "board_0";
			kernel = "kernel";
			fdt = "fdt-0";
			fpga = "fpga-0";
			signature {
				algo = "crc32";
				key-name-hint = "dev";
				sign-images = "fdt-0", "kernel", "fpga-0";
			};
		};

		board-1 {
			description = "board_1";
			kernel = "kernel";
			fdt = "fdt-1";
			fpga = "fpga-1";
			signature {
				algo = "crc32";
				key-name-hint = "dev";
				sign-images = "fdt-1", "kernel", "fpga-1";
			};
		};

		board-3 {
			description = "board_3";
			kernel = "kernel";
			fdt = "fdt-3";
			fpga = "fpga-3";
			signature {
				algo = "crc32";
				key-name-hint = "dev";
				sign-images = "fdt-3", "kernel", "fpga-3";
			};
		};
	};
};
```

## recipes-kernel/linux/linux-socfpga-lts/fit_kernel_agilex5_devkit.its
```
// SPDX-License-Identifier: GPL-2.0
/*
 * Copyright (C) 2023 Intel Corporation
 *
 */

/dts-v1/;

/ {
	description = "FIT image with kernel, DTB and FPGA core binary";
	#address-cells = <1>;

	images {
		kernel {
			description = "Linux Kernel";
			data = /incbin/("./Image.lzma");
			type = "kernel";
			arch = "arm64";
			os = "linux";
			compression = "lzma";
			load = <0x86000000>;
			entry = <0x86000000>;
			hash {
				algo = "crc32";
			};
		};

		fdt-0 {
			description = "socfpga_socdk_vanilla";
			data = /incbin/("./socfpga_agilex5_vanilla.dtb");
			type = "flat_dt";
			arch = "arm64";
			compression = "none";
			hash {
				algo = "crc32";
			};
		};
		
		fdt-1 {
            description = "socfpga_socdk_nand";
            data = /incbin/("./socfpga_agilex5_socdk_nand.dtb");
            type = "flat_dt";
            arch = "arm64";
            compression = "none";
            hash {
                algo = "crc32";
            };
        };
		
		fdt-2 {
            description = "socfpga_socdk_emmc";
            data = /incbin/("./socfpga_agilex5_socdk_emmc.dtb");
            type = "flat_dt";
            arch = "arm64";
            compression = "none";
			hash {
                algo = "crc32";
            };
        };
		
		fdt-4 {
            description = "socfpga_socdk_combined";
            data = /incbin/("./socfpga_agilex5_socdk.dtb");
            type = "flat_dt";
            arch = "arm64";
            compression = "none";
            hash {
                algo = "crc32";
            };
        };
		
		fdt-5 {
			description = "socfpga_socdk_aic0";
			data = /incbin/("./socfpga_agilex5_socdk_aic0.dtb");
			type = "flat_dt";
			arch = "arm64";
			compression = "none";
			hash {
				algo = "crc32";
			};
		};

		fdt-6 {
			description = "socfpga_socdk_debug2";
			data = /incbin/("./socfpga_agilex5_socdk_debug2.dtb");
			type = "flat_dt";
			arch = "arm64";
			compression = "none";
			hash {
				algo = "crc32";
			};
		};

		fdt-7 {
			description = "vanilla-socfpga_socdk_nand.dtb";
			data = /incbin/("./socfpga_agilex5_socdk_nand_vanilla.dtb");
			type = "flat_dt";
			arch = "arm64";
			compression = "none";
			hash {
				algo = "crc32";
			};
		};

		fpga-1 {
            description = "FPGA bitstream for NAND";
            data = /incbin/("./nand.core.rbf");
            type = "fpga";
            arch = "arm64";
            compression = "none";
            load = <0x8A000000>;
            hash {
                algo = "crc32";
            };
        };

		fpga-2 {
            description = "FPGA bitstream for EMMC";
            data = /incbin/("./emmc.core.rbf");
            type = "fpga";
            arch = "arm64";
            compression = "none";
            load = <0x8A000000>;
            hash {
                algo = "crc32";
            };
        };

        fpga-4 {
            description = "FPGA bitstream for GHRD";
            data = /incbin/("./ghrd.core.rbf");
            type = "fpga";
            arch = "arm64";
            compression = "none";
            load = <0x8A000000>;
            hash {
                algo = "crc32";
            };
        };

		fpga-5 {
            description = "FPGA bitstream for aic0";
            data = /incbin/("./aic0.core.rbf");
            type = "fpga";
            arch = "arm64";
            compression = "none";
            load = <0x8A000000>;
            hash {
                algo = "crc32";
            };
        };

        fpga-6 {
            description = "FPGA bitstream for debug2";
            data = /incbin/("./debug2.core.rbf");
            type = "fpga";
            arch = "arm64";
            compression = "none";
            load = <0x8A000000>;
            hash {
                algo = "crc32";
            };
        };
	};

	configurations {
		default = "board-0";

		board-0 {
			description = "board_0";
			kernel = "kernel";
			fdt = "fdt-0";
			signature {
				algo = "crc32";
				key-name-hint = "dev";
				sign-images = "fdt-0", "kernel";
			};
		};
		board-1 {
            description = "board_1";
            kernel = "kernel";
            fdt = "fdt-1";
            fpga = "fpga-1";
            signature {
                algo = "crc32";
                key-name-hint = "dev";
                sign-images = "fdt-1", "kernel", "fpga-1";
            };
        };

		board-2 {
            description = "board_2";
            kernel = "kernel";
            fdt = "fdt-2";
            fpga = "fpga-2";
            signature {
                algo = "crc32";
                key-name-hint = "dev";
                sign-images = "fdt-2", "kernel", "fpga-2";
            };
        };

        board-4 {
            description = "board_4";
            kernel = "kernel";
            fdt = "fdt-4";
            fpga = "fpga-4";
            signature {
                algo = "crc32";
                key-name-hint = "dev";
                sign-images = "fdt-4", "kernel", "fpga-4";
            };
        };

		board-5 {
            description = "board_5";
            kernel = "kernel";
            fdt = "fdt-4";
            fpga = "fpga-4";
            signature {
                algo = "crc32";
                key-name-hint = "dev";
                sign-images = "fdt-5", "kernel", "fpga-5";
            };
        };

        board-6 {
            description = "board_6";
            kernel = "kernel";
            fdt = "fdt-6";
            fpga = "fpga-6";
            signature {
                algo = "crc32";
                key-name-hint = "dev";
                sign-images = "fdt-6", "kernel", "fpga-6";
            };
        };

        board-7 {
            description = "board_7";
            kernel = "kernel";
            fdt = "fdt-7";
            signature {
                algo = "crc32";
                key-name-hint = "dev";
                sign-images = "fdt-7", "kernel";
            };
        };
	};
};
```

## recipes-kernel/linux/linux-socfpga-lts/fit_kernel_agilex5_mk_a5e065bb32aes1.its
```
// SPDX-License-Identifier: GPL-2.0
/*
 * Copyright (C) 2023 Intel Corporation
 *
 */

/dts-v1/;

/ {
	description = "FIT image with kernel, DTB and FPGA core binary";
	#address-cells = <1>;

	images {
		kernel {
			description = "Linux Kernel";
			data = /incbin/("./Image.lzma");
			type = "kernel";
			arch = "arm64";
			os = "linux";
			compression = "lzma";
			load = <0x86000000>;
			entry = <0x86000000>;
			hash {
				algo = "crc32";
			};
		};

		fdt-0 {
			description = "socfpga_socdk_vanilla";
			data = /incbin/("./socfpga_agilex5_vanilla.dtb");
			type = "flat_dt";
			arch = "arm64";
			compression = "none";
			hash {
				algo = "crc32";
			};
		};

		fdt-4 {
            description = "socfpga_socdk_combined";
            data = /incbin/("./socfpga_agilex5_socdk.dtb");
            type = "flat_dt";
            arch = "arm64";
            compression = "none";
            hash {
                algo = "crc32";
            };
        };

        fpga-4 {
            description = "FPGA bitstream for GHRD";
            data = /incbin/("./ghrd.core.rbf");
            type = "fpga";
            arch = "arm64";
            compression = "none";
            load = <0x8A000000>;
            hash {
                algo = "crc32";
            };
        };
	};

	configurations {
		default = "board-0";

		board-0 {
			description = "board_0";
			kernel = "kernel";
			fdt = "fdt-0";
			signature {
				algo = "crc32";
				key-name-hint = "dev";
				sign-images = "fdt-0", "kernel";
			};
		};

        board-4 {
            description = "board_4";
            kernel = "kernel";
            fdt = "fdt-4";
            fpga = "fpga-4";
            signature {
                algo = "crc32";
                key-name-hint = "dev";
                sign-images = "fdt-4", "kernel", "fpga-4";
            };
        };
	};
};
```

## recipes-kernel/linux/linux-socfpga-lts/fit_kernel_n5x.its
```
// SPDX-License-Identifier: GPL-2.0
/*
 * Copyright (C) 2023 Intel Corporation
 *
 */

/dts-v1/;

/ {
	description = "FIT image with kernel, DTB and FPGA core binary";
	#address-cells = <1>;
	
	images {
		kernel {
			description = "Linux Kernel";
			data = /incbin/("./Image.lzma");
			type = "kernel";
			arch = "arm64";
			os = "linux";
			compression = "lzma";
			load = <0x6000000>;
			entry = <0x6000000>;
			hash {
				algo = "crc32";
			};
		};

		fdt {
			description = "Linux DTB";
			data = /incbin/("./linux.dtb");
			type = "flat_dt";
			arch = "arm64";
			compression = "none";
			hash {
				algo = "crc32";
			};
		};
	};

	configurations {
		default = "conf";
		conf {
			description = "Intel SoC64 FPGA";
			kernel = "kernel";
			fdt = "fdt";
			signature {
				algo = "crc32";
				key-name-hint = "dev";
				sign-images = "fdt", "kernel";
			};
		};
	};
};
```
