## conf/machine/agilex-gsrd.conf
```bitbake
#@TYPE: Machine
#@NAME: Intel SoCFPGA Agilex
#@DESCRIPTION: Additional machine configuration for the Agilex SoCFPGA

IMAGE_TYPE:agilex ?= "gsrd"

UBOOT_CONFIG:agilex ?= "agilex-socdk-atf agilex-socdk-qspi-atf"

KERNEL_DEVICETREE = " "

MACHINE_ESSENTIAL_EXTRA_RRECOMMENDS:append:agilex = " \
		kernel-modules \
		device-tree \
		hw-ref-design \
		"

EXTRA_IMAGEDEPENDS:append:agilex = " \
		u-boot-socfpga-scr \
		u-boot-socfpga-env \
		"

IMAGE_BOOT_FILES:agilex = " \
		boot.scr.uimg \
		u-boot.itb \
		kernel.itb \
		"
```

## conf/machine/agilex5-gsrd.conf
```bitbake
#@TYPE: Machine
#@NAME: Intel SoCFPGA Agilex5
#@DESCRIPTION: Additional machine configuration for the Agilex5 SoCFPGA

IMAGE_TYPE:agilex5 ?= "gsrd"

UBOOT_CONFIG:agilex5 ?= "agilex5-socdk-atf"

KERNEL_DEVICETREE:agilex5 ?= " \
		intel/socfpga_agilex5_socdk.dtb \
		"

MACHINE_ESSENTIAL_EXTRA_RRECOMMENDS:append:agilex5 = " \
		kernel-modules \
		kernel-devicetree \
		"

EXTRA_IMAGEDEPENDS:append:agilex5 = " \
		u-boot-socfpga-scr \
		"

IMAGE_BOOT_FILES:agilex5 = " \
		boot.scr.uimg \
		u-boot.itb \
		kernel.itb \
		"
```

## conf/machine/agilex5_devkit-gsrd.conf
```bitbake
#@TYPE: Machine
#@NAME: Intel SoCFPGA Agilex5
#@DESCRIPTION: Additional machine configuration for the Agilex5 SoCFPGA

IMAGE_TYPE:agilex5_devkit ?= "gsrd"

UBOOT_CONFIG:agilex5_devkit ?= "agilex5_devkit-socdk-atf agilex5_devkit-socdk-nand-atf"

# KERNEL_DEVICETREE:agilex5 ?= " \
# 		intel/socfpga_agilex5_socdk.dtb \
#     intel/socfpga_agilex5_socdk_swvp.dtb \
# 		"
KERNEL_DEVICETREE = " "

IMAGE_INSTALL:append:agilex5_devkit = " \
		${@bb.utils.contains( 'IMAGE_BASENAME', "gsrd-console-image", " packagegroup-tsn-essential", "", d)} \
		"

MACHINE_ESSENTIAL_EXTRA_RRECOMMENDS:append:agilex5_devkit = " \
		kernel-modules \
		device-tree \
		hw-ref-design \
		"

EXTRA_IMAGEDEPENDS:append:agilex5_devkit = " \
		u-boot-socfpga-scr \
		"

IMAGE_BOOT_FILES:agilex5_devkit = " \
		boot.scr.uimg \
		u-boot.itb \
		kernel.itb \
		"
```

## conf/machine/agilex5_dk_a5e013bb32aesi0-gsrd.conf
```bitbake
#@TYPE: Machine
#@NAME: Intel SoCFPGA Agilex5
#@DESCRIPTION: Additional machine configuration for the Agilex5 SoCFPGA

IMAGE_TYPE:agilex5_dk_a5e013bb32aesi0 ?= "gsrd"

UBOOT_CONFIG:agilex5_dk_a5e013bb32aesi0 ?= "agilex5_dk_a5e013bb32aesi0-socdk-atf agilex5_dk_a5e013bb32aesi0-socdk-nand-atf"

KERNEL_DEVICETREE = " "

IMAGE_INSTALL:append:agilex5_dk_a5e013bb32aesi0 = " \
		${@bb.utils.contains( 'IMAGE_BASENAME', "gsrd-console-image", " packagegroup-tsn-essential", "", d)} \
		"

MACHINE_ESSENTIAL_EXTRA_RRECOMMENDS:append:agilex5_dk_a5e013bb32aesi0 = " \
		kernel-modules \
		device-tree \
		hw-ref-design \
		"

EXTRA_IMAGEDEPENDS:append:agilex5_dk_a5e013bb32aesi0 = " \
		u-boot-socfpga-scr \
		"

IMAGE_BOOT_FILES:agilex5_dk_a5e013bb32aesi0 = " \
		boot.scr.uimg \
		u-boot.itb \
		kernel.itb \
		"

HYP_BUILD ?= "0"
XEN_EXTRA_PACKAGES = ""
XEN_EXTRA_PACKAGES:append = "${@'kernel-module-xen-blkback kernel-module-xen-gntalloc kernel-module-xen-gntdev kernel-module-xen-netback kernel-module-xen-wdt xen xen-tools xen-tools-xenstat ' if d.getVar('HYP_BUILD') == '1' else ''}"
IMAGE_INSTALL:append:agilex5_dk_a5e013bb32aesi0 = "${@' socfpga-xen-passthrough' if d.getVar('HYP_BUILD') == '1' else ''}"
IMAGE_BOOT_FILES:append:agilex5_dk_a5e013bb32aesi0 = "${@' xen Image devicetree/socfpga_agilex5_vanilla.dtb devicetree/socfpga_agilex5_socdk_nand_vanilla.dtb devicetree/socfpga_agilex5_socdk_debug_vanilla.dtb devicetree/socfpga_agilex5_socdk_emmc_vanilla.dtb devicetree/socfpga_agilex5_socdk_aic0.dtb devicetree/socfpga_agilex5_socdk_tsn_cfg2.dtb boot.scr.xen.uimg boot.scr.xen.nand.uimg boot.scr.xen.debug.uimg agilex5_dk_a5e013bb32aesi0_gsrd_ghrd/ghrd.core.rbf agilex5_dk_a5e013bb32aesi0_gsrd_ghrd/emmc.core.rbf agilex5_dk_a5e013bb32aesi0_gsrd_ghrd/debug2.core.rbf agilex5_dk_a5e013bb32aesi0_gsrd_ghrd/tsnconfig2.core.rbf agilex5_dk_a5e013bb32aesi0_gsrd_ghrd/aic0.core.rbf' if d.getVar('HYP_BUILD') == '1' else ''}"
```

## conf/machine/agilex5_dk_a5e065bb32aes1-gsrd.conf
```bitbake
#@TYPE: Machine
#@NAME: Intel SoCFPGA Agilex5
#@DESCRIPTION: Additional machine configuration for the Agilex5 SoCFPGA

IMAGE_TYPE:agilex5_dk_a5e065bb32aes1 ?= "gsrd"

UBOOT_CONFIG:agilex5_dk_a5e065bb32aes1 ?= "agilex5_dk_a5e065bb32aes1-socdk-atf agilex5_dk_a5e065bb32aes1-socdk-nand-atf"

KERNEL_DEVICETREE = " "

IMAGE_INSTALL:append:agilex5_dk_a5e065bb32aes1 = " \
		${@bb.utils.contains( 'IMAGE_BASENAME', "gsrd-console-image", " packagegroup-tsn-essential", "", d)} \
		"

MACHINE_ESSENTIAL_EXTRA_RRECOMMENDS:append:agilex5_dk_a5e065bb32aes1 = " \
		kernel-modules \
		device-tree \
		hw-ref-design \
		"

EXTRA_IMAGEDEPENDS:append:agilex5_dk_a5e065bb32aes1 = " \
		u-boot-socfpga-scr \
		"

IMAGE_BOOT_FILES:agilex5_dk_a5e065bb32aes1 = " \
		boot.scr.uimg \
		u-boot.itb \
		kernel.itb \
		"
```

## conf/machine/agilex5_modular-gsrd.conf
```bitbake
#@TYPE: Machine
#@NAME: Intel SoCFPGA Agilex5
#@DESCRIPTION: Additional machine configuration for the Agilex5 SoCFPGA

IMAGE_TYPE:agilex5_modular ?= "gsrd"

UBOOT_CONFIG:agilex5_modular ?= "agilex5_modular-socdk-atf"

KERNEL_DEVICETREE = " "

IMAGE_INSTALL:append:agilex5_modular = " \
		${@bb.utils.contains( 'IMAGE_BASENAME', "gsrd-console-image", " packagegroup-tsn-essential", "", d)} \
		"

MACHINE_ESSENTIAL_EXTRA_RRECOMMENDS:append:agilex5_modular = " \
		kernel-modules \
		device-tree \
		hw-ref-design \
		"

EXTRA_IMAGEDEPENDS:append:agilex5_modular = " \
		u-boot-socfpga-scr \
		"

IMAGE_BOOT_FILES:agilex5_modular = " \
		boot.scr.uimg \
		u-boot.itb \
		kernel.itb \
		"
HYP_BUILD ?= "0"
XEN_EXTRA_PACKAGES = ""
XEN_EXTRA_PACKAGES:append = "${@'kernel-module-xen-blkback kernel-module-xen-gntalloc kernel-module-xen-gntdev kernel-module-xen-netback kernel-module-xen-wdt xen xen-tools xen-tools-xenstat ' if d.getVar('HYP_BUILD') == '1' else ''}"
IMAGE_INSTALL:append:agilex5_modular = "${@' socfpga-xen-passthrough' if d.getVar('HYP_BUILD') == '1' else ''}"
IMAGE_BOOT_FILES:append:agilex5_modular =  "${@' xen Image devicetree/socfpga_agilex5_vanilla.dtb  boot.scr.xen.uimg agilex5_modular_gsrd_ghrd/ghrd.core.rbf' if d.getVar('HYP_BUILD') == '1' else ''}"
```

## conf/machine/agilex5_mucv-gsrd.conf
```bitbake
#@TYPE: Machine
#@NAME: Intel SoCFPGA Agilex5
#@DESCRIPTION: Additional machine configuration for the Agilex5 SoCFPGA

IMAGE_TYPE:agilex5_mucv ?= "gsrd"

UBOOT_CONFIG:agilex5_mucv ?= "agilex5-socdk-atf"

# KERNEL_DEVICETREE:agilex5 ?= " \
# 		intel/socfpga_agilex5_socdk.dtb \
#     intel/socfpga_agilex5_socdk_swvp.dtb \
# 		"
KERNEL_DEVICETREE = " "

MACHINE_ESSENTIAL_EXTRA_RRECOMMENDS:append:agilex5_mucv = " \
		kernel-modules \
		device-tree \
		hw-ref-design \
		"

EXTRA_IMAGEDEPENDS:append:agilex5_mucv = " \
		u-boot-socfpga-scr \
		"

IMAGE_BOOT_FILES:agilex5_mucv = " \
		boot.scr.uimg \
		u-boot.itb \
		kernel.itb \
		"
```

## conf/machine/agilex5_mudv_bbr-gsrd.conf
```bitbake
#@TYPE: Machine
#@NAME: Intel SoCFPGA Agilex5
#@DESCRIPTION: Additional machine configuration for the Agilex5 SoCFPGA

IMAGE_TYPE:agilex5_mudv_bbr ?= "gsrd"

UBOOT_CONFIG:agilex5_mudv_bbr ?= "agilex5-socdk-atf"

# KERNEL_DEVICETREE:agilex5 ?= " \
# 		intel/socfpga_agilex5_socdk.dtb \
#     intel/socfpga_agilex5_socdk_swvp.dtb \
# 		"
KERNEL_DEVICETREE = " "

MACHINE_ESSENTIAL_EXTRA_RRECOMMENDS:append:agilex5_mudv_bbr = " \
		kernel-modules \
		device-tree \
		hw-ref-design \
		"

EXTRA_IMAGEDEPENDS:append:agilex5_mudv_bbr = " \
		u-boot-socfpga-scr \
		"

IMAGE_BOOT_FILES:agilex5_mudv_bbr = " \
		boot.scr.uimg \
		u-boot.itb \
		kernel.itb \
		"
```

## conf/machine/agilex5_mudv_cvr-gsrd.conf
```bitbake
#@TYPE: Machine
#@NAME: Intel SoCFPGA Agilex5
#@DESCRIPTION: Additional machine configuration for the Agilex5 SoCFPGA

IMAGE_TYPE:agilex5_mudv_cvr ?= "gsrd"

UBOOT_CONFIG:agilex5_mudv_cvr ?= "agilex5-socdk-atf"

# KERNEL_DEVICETREE:agilex5 ?= " \
# 		intel/socfpga_agilex5_socdk.dtb \
#     intel/socfpga_agilex5_socdk_swvp.dtb \
# 		"
KERNEL_DEVICETREE = " "

IMAGE_INSTALL:append:agilex5_mudv_cvr = " \
		${@bb.utils.contains( 'IMAGE_BASENAME', "gsrd-console-image", " packagegroup-tsn-essential", "", d)} \
		"

MACHINE_ESSENTIAL_EXTRA_RRECOMMENDS:append:agilex5_mudv_cvr = " \
		kernel-modules \
		device-tree \
		hw-ref-design \
		"

EXTRA_IMAGEDEPENDS:append:agilex5_mudv_cvr = " \
		u-boot-socfpga-scr \
		"

IMAGE_BOOT_FILES:agilex5_mudv_cvr = " \
		boot.scr.uimg \
		u-boot.itb \
		kernel.itb \
		"
```

## conf/machine/agilex5_mudv_mod-gsrd.conf
```bitbake
#@TYPE: Machine
#@NAME: Intel SoCFPGA Agilex5
#@DESCRIPTION: Additional machine configuration for the Agilex5 SoCFPGA

IMAGE_TYPE:agilex5_mudv_mod ?= "gsrd"

UBOOT_CONFIG:agilex5_mudv_mod ?= "agilex5-socdk-atf"

# KERNEL_DEVICETREE:agilex5 ?= " \
# 		intel/socfpga_agilex5_socdk.dtb \
#     intel/socfpga_agilex5_socdk_swvp.dtb \
# 		"
KERNEL_DEVICETREE = " "

MACHINE_ESSENTIAL_EXTRA_RRECOMMENDS:append:agilex5_mudv_mod = " \
		kernel-modules \
		device-tree \
		hw-ref-design \
		"

EXTRA_IMAGEDEPENDS:append:agilex5_mudv_mod = " \
		u-boot-socfpga-scr \
		"

IMAGE_BOOT_FILES:agilex5_mudv_mod = " \
		boot.scr.uimg \
		u-boot.itb \
		kernel.itb \
		"
```

## conf/machine/agilex7_dk_si_agf014ea-gsrd.conf
```bitbake
#@TYPE: Machine
#@NAME: Intel SoCFPGA Agilex7 DK-SI-AGF014EA
#@DESCRIPTION: Additional machine configuration for the Agilex7 DK-SI-AGF014EA SoCFPGA

IMAGE_TYPE ?= "gsrd"

UBOOT_CONFIG ?= "agilex-socdk-atf agilex-socdk-qspi-atf"

KERNEL_DEVICETREE = " "

MACHINE_ESSENTIAL_EXTRA_RRECOMMENDS:append ?= " \
		kernel-modules \
		device-tree \
		hw-ref-design \
		"

EXTRA_IMAGEDEPENDS:append ?= " \
		u-boot-socfpga-scr \
		"

IMAGE_BOOT_FILES = " \
		boot.scr.uimg \
		u-boot.itb \
		kernel.itb \
		"

HYP_BUILD ?= "0"
XEN_EXTRA_PACKAGES = ""
XEN_EXTRA_PACKAGES:append = "${@'kernel-module-xen-blkback kernel-module-xen-gntalloc kernel-module-xen-gntdev kernel-module-xen-netback kernel-module-xen-wdt xen xen-tools xen-tools-xenstat ' if d.getVar('HYP_BUILD') == '1' else ''}"
IMAGE_INSTALL:append:agilex7_dk_si_agf014ea = "${@' socfpga-xen-passthrough' if d.getVar('HYP_BUILD') == '1' else ''}"
IMAGE_BOOT_FILES:append:agilex7_dk_si_agf014ea = "${@' xen Image devicetree/socfpga_agilex7_vanilla.dtb boot.scr.xen.uimg' if d.getVar('HYP_BUILD') == '1' else ''}"
```

## conf/machine/agilex7_dk_si_agf014eb-gsrd.conf
```bitbake
#@TYPE: Machine
#@NAME: Intel SoCFPGA Agilex7 DK-SI-AGF014EB (LINEAR) 
#@DESCRIPTION: Additional machine configuration for the Agilex7 DK-SI-AGF014EB (LINEAR) SoCFPGA

IMAGE_TYPE ?= "gsrd"

UBOOT_CONFIG ?= "agilex-socdk-atf agilex-socdk-qspi-atf"

KERNEL_DEVICETREE = " "

MACHINE_ESSENTIAL_EXTRA_RRECOMMENDS:append ?= " \
		kernel-modules \
		device-tree \
		hw-ref-design \
		"

EXTRA_IMAGEDEPENDS:append ?= " \
		u-boot-socfpga-scr \
		"

IMAGE_BOOT_FILES = " \
		boot.scr.uimg \
		u-boot.itb \
		kernel.itb \
		"
```

## conf/machine/agilex_fm61-gsrd.conf
```bitbake
#@TYPE: Machine
#@NAME: Intel SoCFPGA Agilex FM61
#@DESCRIPTION: Additional machine configuration for the Agilex FM61 SoCFPGA

IMAGE_TYPE ?= "gsrd"

UBOOT_CONFIG ?= "agilex-socdk-atf agilex-socdk-qspi-atf"

KERNEL_DEVICETREE = " "

MACHINE_ESSENTIAL_EXTRA_RRECOMMENDS:append ?= " \
		kernel-modules \
		device-tree \
		hw-ref-design \
		"

EXTRA_IMAGEDEPENDS:append ?= " \
		u-boot-socfpga-scr \
		"

IMAGE_BOOT_FILES = " \
		boot.scr.uimg \
		u-boot.itb \
		kernel.itb \
		"
```

## conf/machine/agilex_fm61_linear-gsrd.conf
```bitbake
#@TYPE: Machine
#@NAME: Intel SoCFPGA Agilex FM61 B2 Linear (Non-ENPIRION) 
#@DESCRIPTION: Additional machine configuration for the Agilex FM61 B2 Linear (Non-ENPIRION) SoCFPGA

IMAGE_TYPE ?= "gsrd"

UBOOT_CONFIG ?= "agilex-socdk-atf agilex-socdk-qspi-atf"

KERNEL_DEVICETREE = " "

MACHINE_ESSENTIAL_EXTRA_RRECOMMENDS:append ?= " \
		kernel-modules \
		device-tree \
		hw-ref-design \
		"

EXTRA_IMAGEDEPENDS:append ?= " \
		u-boot-socfpga-scr \
		"

IMAGE_BOOT_FILES = " \
		boot.scr.uimg \
		u-boot.itb \
		kernel.itb \
		"
```

## conf/machine/agilex_fm86-gsrd.conf
```bitbake
#@TYPE: Machine
#@NAME: Intel SoCFPGA Agilex FM86
#@DESCRIPTION: Additional machine configuration for the Agilex FM86 SoCFPGA

require conf/machine/agilex_fm61-gsrd.conf

UBOOT_CONFIG:agilex_fm86 ?= "agilex_fm86-socdk-atf agilex_fm86-socdk-qspi-atf"
```

## conf/machine/agilex_fm87-gsrd.conf
```bitbake
#@TYPE: Machine
#@NAME: Intel SoCFPGA Agilex
#@DESCRIPTION: Additional machine configuration for the Agilex SoCFPGA

require conf/machine/agilex-gsrd.conf

UBOOT_CONFIG:agilex_fm87 ?= "agilex_fm87-socdk-atf agilex_fm87-socdk-qspi-atf"
```

## conf/machine/agilex_fm87_linear-gsrd.conf
```bitbake
#@TYPE: Machine
#@NAME: Intel SoCFPGA Agilex FM87 B2 Linear (Non-ENPIRION)
#@DESCRIPTION: Additional machine configuration for the Agilex FM87 B2 Linear (Non-ENPIRION) SoCFPGA

require conf/machine/agilex_fm61-gsrd.conf

UBOOT_CONFIG:agilex_fm87_linear ?= "agilex_fm87-socdk-atf agilex_fm87-socdk-qspi-atf"
```

## conf/machine/arria10-gsrd.conf
```bitbake
#@TYPE: Machine
#@NAME: Intel SoCFPGA Arria10
#@DESCRIPTION: Machine configuration for the Arria 10 SoCFPGA

IMAGE_TYPE:arria10 ?= "gsrd"

KERNEL_DEVICETREE:arria10 = "\
		intel/socfpga/socfpga_arria10_socdk_sdmmc.dtb \
		${@bb.utils.contains("IMAGE_TYPE", "nand", "intel/socfpga/socfpga_arria10_socdk_nand.dtb", "", d)} \
		${@bb.utils.contains("IMAGE_TYPE", "qspi", "intel/socfpga/socfpga_arria10_socdk_qspi.dtb", "", d)} \
		${@bb.utils.contains("IMAGE_TYPE", "pr", "intel/socfpga/fpga_static_region.dtb", "", d)} \
		${@bb.utils.contains("IMAGE_TYPE", "pr", "intel/socfpga/persona0.dtb", "", d)} \
		${@bb.utils.contains("IMAGE_TYPE", "pr", "intel/socfpga/persona1.dtb", "", d)} \
		"

EXTRA_IMAGEDEPENDS:append:arria10 = " \
		u-boot-socfpga-env \
		${@bb.utils.contains("IMAGE_TYPE", "pr", " u-boot-socfpga-scr", "", d)} \
		${@bb.utils.contains("IMAGE_TYPE", "pr", "", " hw-ref-design", d)} \
		"

MACHINE_ESSENTIAL_EXTRA_RRECOMMENDS:append:arria10 = " \
		${@bb.utils.contains("IMAGE_TYPE", "pr", " kernel-devicetree", "", d)} \
		${@bb.utils.contains("IMAGE_TYPE", "pr", " hw-ref-design", "", d)} \
		"

IMAGE_BOOT_FILES:arria10 = "\
		${@bb.utils.contains("IMAGE_TYPE", "gsrd", "socfpga_arria10_socdk_sdmmc.dtb", "", d)} \
		${@bb.utils.contains("IMAGE_TYPE", "pcie", "socfpga_arria10_socdk_sdmmc.dtb", "", d)} \
		${@bb.utils.contains("IMAGE_TYPE", "pr", "socfpga_arria10_socdk_sdmmc.dtb", "", d)} \
		${@bb.utils.contains("IMAGE_TYPE", "sgmii", "socfpga_arria10_socdk_sdmmc.dtb", "", d)} \
		${@bb.utils.contains("IMAGE_TYPE", "tse", "socfpga_arria10_socdk_sdmmc.dtb", "", d)} \
		fit_spl_fpga_${IMAGE_TYPE}.itb;fit_spl_fpga.itb \
		${KERNEL_IMAGETYPE} \
		${UBOOT_BINARY} \
		extlinux.conf;extlinux/extlinux.conf \
		${@bb.utils.contains("IMAGE_TYPE", "pr", "boot.scr", "", d)} \
		"
```

## conf/machine/cyclone5-gsrd.conf
```bitbake
#@TYPE: Machine
#@NAME: cyclone5
#@DESCRIPTION: Machine configuration for the Cyclone V SoC" 

IMAGE_TYPE:cyclone5 ?= "gsrd"

KERNEL_DEVICETREE:cyclone5 = "socfpga_cyclone5_socdk.dtb"

EXTRA_IMAGEDEPENDS:cyclone5 += "hw-ref-design u-boot-socfpga-scr"

IMAGE_BOOT_FILES:cyclone5 = " \
	${KERNEL_DEVICETREE} \
	${KERNEL_IMAGETYPE} \
	extlinux.conf;extlinux/extlinux.conf \
	u-boot.scr \
	${MACHINE}_${IMAGE_TYPE}_ghrd/soc_system.rbf;soc_system.rbf \
	"
```

## conf/machine/n5x-gsrd.conf
```bitbake
#@TYPE: Machine
#@NAME: Intel SoCFPGA Agilex5
#@DESCRIPTION: Additional machine configuration for the Agilex5 SoCFPGA

KERNEL_DEVICETREE:n5x ?= " \
		intel/socfpga_n5x_socdk.dtb \
		"

MACHINE_ESSENTIAL_EXTRA_RRECOMMENDS:append:n5x = " \
		kernel-devicetree \
		"
```
